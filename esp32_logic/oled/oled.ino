#include <Wire.h>
#include <SPI.h>
#include <Adafruit_GFX.h>
#include <Adafruit_SSD1306.h>

#define SCR_W 128
#define SCR_H 64

Adafruit_SSD1306 display(SCR_W, SCR_H, &Wire, 4);

// gpio pins
#define POT_INP 39
#define BTN 27

// input/output values
int potVal;
int potTimer = 0;
const int potScrollCooldown = 40;

int btnVal;
int btnTimer = 0;
const int btnCooldown = 30;

// stockfish & board settings
const int eloBounds[] = {200, 3000};
int elo = 1600;
const int depthBounds[] = {4, 20};
int depth = 12;
char colours[] = {'R', 'W', 'B'};
char * colourPtr = colours; // W = white, B = black, R = random

// menu vars
int menuX = 16;
int menuY = 8;
String menuOptions[] = {"Start", "Elo", "Depth", "Colour"};
int numMenuOptions = sizeof(menuOptions)/sizeof(menuOptions[0]);
int menuVal = 0;

// display vars
enum State {
  Playing,
  EloMenu,
  DepthMenu,
  ColourMenu,
  Menu
};

enum State displayState = Menu;

int potValCenterRange[] = {1600, 2100};

// bitmap data
static const unsigned char PROGMEM amongus_bmp[1391] = {
    0xff, 0xff, 0xff, 0xff, 0xff, 0xff, 0xff, 0xff, 0xff, 0xff, 0xff, 0xff, 0xf0, 
    0xff, 0xff, 0xff, 0xff, 0xff, 0xff, 0xff, 0xff, 0xff, 0xff, 0xff, 0xff, 0xf0, 
    0xff, 0xff, 0xff, 0xff, 0xff, 0xff, 0xff, 0xff, 0xff, 0xff, 0xff, 0xff, 0xf0, 
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    0xff, 0xff, 0xff, 0xff, 0xff, 0xff, 0xff, 0xff, 0xff, 0xff, 0xff, 0xff, 0xf0
};

static const unsigned char PROGMEM amongus_small_bmp[128] = {
    0x00, 0x00, 0x00, 0x00, 
    0x00, 0x00, 0x00, 0x00, 
    0x00, 0x00, 0x00, 0x00, 
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    0x00, 0x00, 0x00, 0x00
};

static const unsigned char PROGMEM dice_bmp[200] = {
    0xff, 0xff, 0xff, 0xff, 0xff, 
    0xff, 0xff, 0xff, 0xff, 0xff, 
    0xff, 0xff, 0xff, 0xff, 0xff, 
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    0xff, 0xff, 0xff, 0xff, 0xff
};

static const unsigned char PROGMEM wqueen_bmp[132] = {
  0x00, 0x00, 0x00, 
    0x00, 0x00, 0x00, 
    0x00, 0x00, 0x00, 
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    0x00, 0x00, 0x00
};

static const unsigned char PROGMEM bqueen_bmp[132] = {
  0xff, 0xff, 0xff, 
    0xff, 0xff, 0xff, 
    0xff, 0xff, 0xff, 
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    0xff, 0xff, 0xff
};
void setup() {
  // custom I2C pins
  Wire.setPins(33, 32);
  Wire.begin();
  // yea
  Serial.begin(9600);
  // set pin modes
  pinMode(POT_INP, INPUT);
  pinMode(BTN, INPUT_PULLUP);
  // yea
  if (!display.begin(SSD1306_SWITCHCAPVCC, 0x3C)) {
    Serial.println(F("SSD1306 allocation failed"));
    for (;;)
      ;
  }
  // text display settings
  display.setTextSize(2);
  display.setTextColor(WHITE);
}

void loop() {
  btnVal = digitalRead(BTN);
  potVal = analogRead(POT_INP);
  Serial.println(potVal);
  switch(displayState) {
    case Playing:
      displayPlaying();
      handleReset(btnVal);
      break;
    case EloMenu:
      displayElo();
      updateElo();
      handleBtn(btnVal, backToMenu);
      break;
    case DepthMenu:
      displayDepth();
      updateDepth();
      handleBtn(btnVal, backToMenu);
      break;
    case ColourMenu:
      displayColour();
      updateColour();
      handleBtn(btnVal, backToMenu);
      break;
    case Menu:
      displayMenu();
      handleMenuScroll();
      updateMenuSelector();
      handleBtn(btnVal, onPressedMenu);
      break;
  }


  display.display();
}

// HELPER FUNCS
void centerTextAt(int x, int y, String text, int textSize) {
  short int x1, x2;
  short unsigned int size[2] = {0, 0};

  display.setTextSize(textSize);
  display.getTextBounds(text, x, y, &x1, &x2, &size[0], &size[1]);
  display.setCursor(x - size[0] / 2, y - size[1] / 2);
  display.print(text);
}

int getTextHeight(int x, int y, String text, int textSize) {
  short unsigned int size[2] = {0, 0};
  getTextSize(x, y, text, textSize, size);
  return size[1];
}

void getTextSize(int x, int y, String text, int textSize, short unsigned int * size) {
  short int x1, x2;
  // short unsigned int size[2] = {0, 0};

  display.setTextSize(textSize);
  display.getTextBounds(text, x, y, &x1, &x2, &(size[0]), &(size[1]));
  // return size;
}

void smallTitle(String text) {
  display.setCursor(0, 0);
  display.setTextSize(1);
  display.println(text);
}

// - - - - - - - - - - I/O - - - - - - - - - - 
void handleBtn(int btnVal, void (*onPressed)()) {
  if(btnTimer > 0) {
    btnTimer --;
    return;
  }
  if(btnVal == 1) return;
  // beyond this point, button has been pressed and off cooldown
  btnTimer = btnCooldown;
  onPressed();
}

void handleReset(int btnVal) {
  if(potVal == 0 && btnVal == 0) {
    displayState = Menu;
  }
}
// - - - - - - - - - - MAIN MENU - - - - - - - - - - 

void displayMenu() {
  display.clearDisplay();
  int x = menuX;
  int y = menuY;
  display.setTextSize(1);
  String optionValues[numMenuOptions] = {"", String(elo), String(depth), String(*colourPtr)};
  for(int i=0;i<numMenuOptions;i++) {
    display.setCursor(x, y);
    display.print(menuOptions[i]);
    if(i > 0) {
      display.setCursor(x + 50, y);
      display.print("|   " + optionValues[i]);
    }
    
    y += getTextHeight(x, y, menuOptions[i], 1);
  }
}

void handleMenuScroll() {
  if(potTimer > 0) {
    potTimer --;
    return;
  }
  if (potVal > potValCenterRange[0] && potVal < potValCenterRange[1]) return;
  potTimer = potScrollCooldown;
  if(potVal < potValCenterRange[0]) { // bkwd
    menuVal = (menuVal + numMenuOptions - 1) % numMenuOptions;
  } else {  // fwd
    menuVal = (menuVal + 1) % numMenuOptions;
  }
}

void updateMenuSelector() {
  int textH = getTextHeight(0, 0, "Aa", 1);
  int selectorW = 6;
  int selectorXSpacing = 4;
  int selectorYOffset = 1;
  int x0 = menuX - selectorW - selectorXSpacing;
  int y0 = menuY + menuVal * textH;
  display.drawTriangle(x0, y0+selectorYOffset, x0, y0-selectorYOffset+textH, x0+selectorW, y0 + textH/2, WHITE);
}

void onPressedMenu() {
  displayState = static_cast<State>(menuVal);
  potTimer = 0;
  Serial.println(displayState);
  // switch(menuVal) {
  //   case Start:
  //     displayState = Playing;
  //     break;
  //   case Elo:
  //     break;
  //   case Depth:
  //     break;
  //   case Colour:
  //     break;
  // }
}

void backToMenu() {
  displayState = Menu;
}

// - - - - - - - - - - ELO MENU - - - - - - - - - - 

void updateElo() {
  if(potVal > potValCenterRange[0] && potVal < potValCenterRange[1]) return; // center of pot

  if(potVal < potValCenterRange[0]-500) { // 0 to 1200
    elo -= 20;
  } else if (potVal < potValCenterRange[0]-250) {  // 1200 to 1450
    elo -= 10;
  } else if (potVal < potValCenterRange[0]) {  // 1450 to 1600
    elo --;
  } else if (potVal < potValCenterRange[1]+250) {  // 2000 to 2250
    elo ++;
  } else if (potVal < potValCenterRange[1]+500) {  // 2250 to 2500
    elo += 10;
  } else {                      // 2500 to max (4095)
    elo += 20;
  }

  // force min/max elo
  if (elo < eloBounds[0]) {
    elo = eloBounds[0];
  } else if(elo > eloBounds[1]) {
    elo = eloBounds[1];
  }
}

void displayElo() {
  display.clearDisplay();
  smallTitle("STOCKFISH ELO");
  centerTextAt(64, 32, String(elo), 2);
}

// - - - - - - - - - - DEPTH MENU - - - - - - - - - - 

void displayDepth() {
  display.clearDisplay();
  smallTitle("STOCKFISH DEPTH");
  centerTextAt(64, 32, String(depth), 2);
}

void updateDepth() {
  if(potTimer > 0) {
    potTimer --;
    return;
  }
  if (potVal > potValCenterRange[0] && potVal < potValCenterRange[1]) return;
  potTimer = 20;
  if(potVal < potValCenterRange[0]) { // bkwd
    depth--;
  } else {  // fwd
    depth++;
  }

  if(depth < depthBounds[0]) {
    depth = depthBounds[0];
  } else if (depth > depthBounds[1]) {
    depth = depthBounds[1];
  }
}

// - - - - - - - - - - COLOUR MENU - - - - - - - - - - 

void displayColour() {
  display.clearDisplay();
  smallTitle("YOU PLAY AS...");
  switch(*colourPtr) {
    case 'W':
      centerTextAt(64, 32, "White", 2);
      break;
    case 'B':
      centerTextAt(64, 32, "Black", 2);
      break;
    case 'R':
      centerTextAt(64, 32, "Rando", 2);
      break;
  }
}

void updateColour() {
  if(potTimer > 0) {
    potTimer --;
    return;
  }
  if (potVal > potValCenterRange[0] && potVal < potValCenterRange[1]) return;
  potTimer = potScrollCooldown;
  if(potVal < potValCenterRange[0]) { // bkwd
    colourPtr --;
  } else {  // fwd
    colourPtr ++;
  }
  if(colourPtr > colours + 2) {
    colourPtr -= 3;
  } else if(colourPtr < colours){
    colourPtr += 3;
  }
  Serial.println(*colourPtr);
}

// void onPressedColour() {
//   displayState = Menu;
// }

// - - - - - - - - - - PLAYING MENU - - - - - - - - - - 

void displayPlaying() {
  displayQueenBlack();
}

// - - - - - - - - - - BITMAPS - - - - - - - - - - 

void displayBitmapTest() {
  display.clearDisplay();

//   int w = 100;
//   int h = 107;
//   display.drawBitmap(
//     (display.width()  - w) / 2,
//     (display.height() - h) / 2 - 6,
//     test, w, h, 1);
// }
  int w = 30;
  int h = 32;
  display.drawBitmap(
    (display.width() - w) / 2,
    (display.height() - h) / 2,
    amongus_small_bmp, w, h, 1);
}

void displayDice() {
  display.clearDisplay();
  int w = 40;
  int h = 40;
  display.drawBitmap(
    (display.width() - w) /2,
    (display.height()-h)/2,
    dice_bmp, w, h, 1);
}

void displayQueenWhite() {
  display.clearDisplay();
  int w = 24;
  int h = 44;
  display.drawBitmap(
    (display.width()-w)/2,
    (display.height()-h)/2,
    wqueen_bmp, w, h, 1
  );
}
void displayQueenBlack() {
  display.clearDisplay();
  int w = 24;
  int h = 44;
  display.drawBitmap(
    (display.width()-w)/2,
    (display.height()-h)/2,
    bqueen_bmp, w, h, 1
  );
}